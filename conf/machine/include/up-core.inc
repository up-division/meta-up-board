## conf/machine/include/up-core.inc
```bitbake
#@TYPE: Machine
#@NAME: up-common

#@DESCRIPTION: Particular machine configuration for up-core boards.

# Include additional ACPI tables with the initrd
EXTRA_IMAGEDEPENDS_append = " acpi-tables"
INITRD_LIVE_prepend = "${DEPLOY_DIR_IMAGE}/acpi-tables.cpio "


# Ampak-firmware, SystemD and network tools
IMAGE_INSTALL_append += " bluez5 systemd"
IMAGE_INSTALL_append += " hostapd wireless-tools dhcp-client iw wpa-supplicant"
IMAGE_INSTALL_append += " ampak-firmware"
DISTRO_FEATURES_append = " bluez5 bluetooth wifi"
DISTRO_FEATURES_BACKFILL_CONSIDERED += "sysvinit"
```

## conf/machine/up-board.conf
```bitbake
#@TYPE: Machine
#@NAME: up-board

#@DESCRIPTION: Machine configuration for UP board systems

PREFERRED_PROVIDER_virtual/kernel ?= "linux-intel"
PREFERRED_VERSION_linux-intel ?= "5.4%"

require conf/machine/include/up-common.inc

# Trigger a panic and subsequent reboot if a kernel driver issues a warning.
# This is intended to help an UP board to recover from a deadlock which is
# known to occur at random during system start-up while requesting an I2C
# bus access semaphore from unresponsive P-Unit platform firmware.
APPEND += " panic_on_warn=1"
```

## conf/machine/up-core.conf
```bitbake
#@TYPE: Machine

#@NAME: up-core

#@DESCRIPTION: Machine configuration for UP Core systems

PREFERRED_PROVIDER_virtual/kernel ?= "linux-intel"
PREFERRED_VERSION_linux-intel ?= "5.4%"

require conf/machine/include/up-common.inc

# Include additional ACPI tables with the initrd
EXTRA_IMAGEDEPENDS_append = " acpi-tables"
INITRD_LIVE_prepend = "${DEPLOY_DIR_IMAGE}/acpi-tables.cpio "

ACPI_TABLES ?= "spidev2.0.asl spidev2.1.asl"

# Ampak-firmware, SystemD and network tools
IMAGE_INSTALL_append += " ampak-firmware"

# Trigger a panic and subsequent reboot if a kernel driver issues a warning.
# This is intended to help an UP board to recover from a deadlock which is
# known to occur at random during system start-up while requesting an I2C
# bus access semaphore from unresponsive P-Unit platform firmware.
APPEND += " panic_on_warn=1"
```

## conf/machine/up-squared-6000-rt.conf
```bitbake
#@TYPE: Machine
#@NAME: up-squared-6000

#@DESCRIPTION: Machine configuration for UP board systems

PREFERRED_PROVIDER_virtual/kernel ?= "linux-intel-rt"
PREFERRED_VERSION_linux-intel ?= "5.15%"

# tgl_u-mr1 kernel version
#LINUX_VERSION ?= "5.15.59"
#SRCREV_machine ?= "efe20512212b0e85b5f884b1bfc8fbba2b43541a"

require conf/machine/include/up-common.inc

# Include additional ACPI tables with the initrd
#EXTRA_IMAGEDEPENDS_append = " acpi-tables"
INITRD_LIVE:prepend = "${DEPLOY_DIR_IMAGE}/acpi-tables.cpio "

ACPI_TABLES ?= "upsquared-6000-spidev1.0.asl upsquared-6000-spidev1.1.asl pinctrl-up-ehl.asl"
```

## conf/machine/up-xtreme-i12-rt.conf
```bitbake
#@TYPE: Machine
#@NAME: up-xtreme-i12

#@DESCRIPTION: Machine configuration for UP board systems

PREFERRED_PROVIDER_virtual/kernel ?= "linux-intel-rt"
PREFERRED_VERSION_linux-intel ?= "5.15%"

# tgl_u-mr1 kernel version
#LINUX_VERSION ?= "5.4.87"
#SRCREV_machine ?= "17d8b8b5eafbe411bb5657cc11fcc29e4821a2c9"

require conf/machine/include/up-common.inc

# Include additional ACPI tables with the initrd
#EXTRA_IMAGEDEPENDS_append = " acpi-tables"
INITRD_LIVE:prepend = "${DEPLOY_DIR_IMAGE}/acpi-tables.cpio "

ACPI_TABLES ?= "upxtreme-i12-spidev1.0.asl upxtreme-i12-spidev1.1.asl"
```

## conf/machine/upx-adlp01.conf
```bitbake
#@TYPE: Machine
#@NAME: upx-adl01p

#@DESCRIPTION: Machine configuration for UP board systems

PREFERRED_PROVIDER_virtual/kernel = "linux-intel-lts"
# this variable key is resolved too late and has to be written manually
# KERNEL_PACKAGE_NAME_pn-${PREFERRED_PROVIDER_virtual/kernel} = "kernel"
KERNEL_PACKAGE_NAME_pn-linux-intel-lts = "kernel"

KERNEL_VERSION_SANITY_SKIP="1"

require conf/machine/include/up-common.inc

# Include additional ACPI tables with the initrd
INITRD_LIVE_prepend = "${DEPLOY_DIR_IMAGE}/acpi-tables.cpio "

#ACPI_TABLES ?= "upxtreme-i11-spidev1.0.asl upxtreme-i11-spidev1.1.asl"

APPEND_append = " i915.force_probe=* i915.enable_guc=7"
```
